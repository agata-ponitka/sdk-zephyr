## CMakeLists.txt
```
# SPDX-License-Identifier: Apache-2.0

cmake_minimum_required(VERSION 3.13.1)

LIST(APPEND QEMU_EXTRA_FLAGS -serial unix:/tmp/bt-stack-tester)

find_package(Zephyr REQUIRED HINTS $ENV{ZEPHYR_BASE})
project(tester)

zephyr_library_include_directories(${ZEPHYR_BASE}/samples/bluetooth)
zephyr_library_include_directories(${NRF_DIR}/subsys/bluetooth/mesh)
target_sources(app PRIVATE
    src/main.c
    src/bttester.c
    src/gap.c
    src/gatt.c
    )
if(CONFIG_BT_L2CAP_DYNAMIC_CHANNEL)
target_sources(app PRIVATE src/l2cap.c)
endif()

if(CONFIG_BT_MESH)
target_sources(app PRIVATE src/mesh.c)
target_sources(app PRIVATE src/mmdl.c)
target_sources(app PRIVATE src/model_handler.c)
endif()
```

## prj.conf
```kconfig
CONFIG_TEST=y
CONFIG_UART_PIPE=y
CONFIG_SYSTEM_WORKQUEUE_STACK_SIZE=2048
CONFIG_MAIN_STACK_SIZE=2560
CONFIG_BT_RX_STACK_SIZE=2560

CONFIG_BT=y
CONFIG_BT_CENTRAL=y
CONFIG_BT_PERIPHERAL=y
CONFIG_BT_PRIVACY=n
CONFIG_BT_SMP=y
CONFIG_BT_SMP_ENFORCE_MITM=n
CONFIG_BT_SIGNING=y
CONFIG_BT_BONDABLE=y
CONFIG_BT_ATT_PREPARE_COUNT=4
CONFIG_BT_GATT_CLIENT=y
CONFIG_BT_L2CAP_DYNAMIC_CHANNEL=y
CONFIG_BT_DEVICE_NAME="Tester"
CONFIG_BT_DEVICE_NAME_MAX=32
CONFIG_BT_DEVICE_NAME_DYNAMIC=y
CONFIG_BT_DEVICE_NAME_GATT_WRITABLE=y

CONFIG_BT_MESH=y
CONFIG_BT_MESH_RELAY=y
CONFIG_BT_MESH_PB_ADV=y
CONFIG_BT_MESH_PB_GATT=y
CONFIG_BT_MESH_LOW_POWER=y
CONFIG_BT_MESH_LPN_AUTO=n
CONFIG_BT_MESH_GATT_PROXY=y
CONFIG_BT_MESH_LABEL_COUNT=2
CONFIG_BT_MESH_SUBNET_COUNT=2
CONFIG_BT_MESH_MODEL_GROUP_COUNT=2
CONFIG_BT_MESH_APP_KEY_COUNT=4
CONFIG_BT_MESH_IV_UPDATE_TEST=y
CONFIG_BT_MESH_CFG_CLI=y
CONFIG_BT_MESH_HEALTH_CLI=y
CONFIG_BT_MESH_FRIEND=y
CONFIG_BT_MESH_FRIEND_QUEUE_SIZE=32
CONFIG_BT_MESH_RX_SEG_MAX=13
CONFIG_BT_MESH_TX_SEG_MSG_COUNT=2
CONFIG_BT_MESH_TX_SEG_MAX=20
CONFIG_BT_COMPANY_ID=0xffff
CONFIG_BT_MESH_MODEL_EXTENSIONS=y

CONFIG_BT_MESH_PLVL_SRV=y
CONFIG_BT_MESH_BATTERY_SRV=y
CONFIG_BT_MESH_LOC_SRV=y
CONFIG_BT_MESH_PROP_SRV=y
CONFIG_BT_MESH_SENSOR_SRV=y
CONFIG_BT_MESH_TIME_SRV=y
CONFIG_BT_MESH_LIGHTNESS_SRV=y
CONFIG_BT_MESH_LIGHT_CTRL_SRV=y
CONFIG_BT_MESH_ONOFF_CLI=y
CONFIG_BT_MESH_LVL_CLI=y
CONFIG_BT_MESH_DTT_CLI=y
CONFIG_BT_MESH_PONOFF_CLI=y
CONFIG_BT_MESH_PLVL_CLI=y
CONFIG_BT_MESH_BATTERY_CLI=y
CONFIG_BT_MESH_LOC_CLI=y
CONFIG_BT_MESH_PROP_CLI=y
CONFIG_BT_MESH_SENSOR_CLI=y
CONFIG_BT_MESH_TIME_CLI=y
CONFIG_BT_MESH_LIGHTNESS_CLI=y
CONFIG_BT_MESH_LIGHT_CTRL_CLI=y

CONFIG_BT_MESH_LIGHT_CTRL_SRV_TIME_FADE_ON=0
CONFIG_BT_MESH_LIGHT_CTRL_SRV_TIME_FADE_PROLONG=0
CONFIG_BT_MESH_LIGHT_CTRL_SRV_TIME_FADE_STANDBY_AUTO=0
CONFIG_BT_MESH_LIGHT_CTRL_SRV_TIME_FADE_STANDBY_MANUAL=0

CONFIG_SETTINGS=n
CONFIG_FLASH=y
CONFIG_FLASH_MAP=y
CONFIG_FCB=y

CONFIG_BT_TINYCRYPT_ECC=y
CONFIG_BT_TESTING=y

CONFIG_UART_CONSOLE=n
```

## src/mesh.c
```c
/* mesh.c - Bluetooth Mesh Tester */

/*
 * Copyright (c) 2017 Intel Corporation
 *
 * SPDX-License-Identifier: Apache-2.0
 */

#include <bluetooth/bluetooth.h>

#include <errno.h>
#include <bluetooth/mesh.h>
#include <bluetooth/testing.h>
#include <sys/byteorder.h>

#define BT_DBG_ENABLED IS_ENABLED(CONFIG_BT_MESH_DEBUG)
#define LOG_MODULE_NAME bttester_mesh
#include "common/log.h"


#include "model_handler.h"
#include "bttester.h"

#define CONTROLLER_INDEX 0

/* Health server data */
extern uint8_t cur_faults[CUR_FAULTS_MAX];
extern uint8_t reg_faults[CUR_FAULTS_MAX * 2];
extern struct bt_mesh_model vnd_models[1];

/* Provision node data */
static uint8_t net_key[16];
static uint16_t net_key_idx;
static uint8_t flags;
static uint32_t iv_index;
static uint16_t addr;
static uint8_t dev_key[16];
static uint8_t input_size;

/* Configured provisioning data */
static uint8_t dev_uuid[16];
static uint8_t static_auth[16];

struct model_data model_bound[MODEL_BOUNDS_MAX];

struct net_ctx net = {
	.local = BT_MESH_ADDR_UNASSIGNED,
	.dst = BT_MESH_ADDR_UNASSIGNED,
};

static void supported_commands(uint8_t *data, uint16_t len)
{
	struct net_buf_simple *buf = NET_BUF_SIMPLE(BTP_DATA_MAX_SIZE);

	net_buf_simple_init(buf, 0);

	/* 1st octet */
	(void)memset(net_buf_simple_add(buf, 1), 0, 1);
	tester_set_bit(buf->data, MESH_READ_SUPPORTED_COMMANDS);
	tester_set_bit(buf->data, MESH_CONFIG_PROVISIONING);
	tester_set_bit(buf->data, MESH_PROVISION_NODE);
	tester_set_bit(buf->data, MESH_INIT);
	tester_set_bit(buf->data, MESH_RESET);
	tester_set_bit(buf->data, MESH_INPUT_NUMBER);
	tester_set_bit(buf->data, MESH_INPUT_STRING);
	/* 2nd octet */
	tester_set_bit(buf->data, MESH_IVU_TEST_MODE);
	tester_set_bit(buf->data, MESH_IVU_TOGGLE_STATE);
	tester_set_bit(buf->data, MESH_NET_SEND);
	tester_set_bit(buf->data, MESH_HEALTH_GENERATE_FAULTS);
	tester_set_bit(buf->data, MESH_HEALTH_CLEAR_FAULTS);
	tester_set_bit(buf->data, MESH_LPN);
	tester_set_bit(buf->data, MESH_LPN_POLL);
	tester_set_bit(buf->data, MESH_MODEL_SEND);
	/* 3rd octet */
	(void)memset(net_buf_simple_add(buf, 1), 0, 1);
#if defined(CONFIG_BT_TESTING)
	tester_set_bit(buf->data, MESH_LPN_SUBSCRIBE);
	tester_set_bit(buf->data, MESH_LPN_UNSUBSCRIBE);
	tester_set_bit(buf->data, MESH_RPL_CLEAR);
#endif /* CONFIG_BT_TESTING */
	tester_set_bit(buf->data, MESH_PROXY_IDENTITY);

	tester_send(BTP_SERVICE_ID_MESH, MESH_READ_SUPPORTED_COMMANDS,
		    CONTROLLER_INDEX, buf->data, buf->len);
}

static void link_open(bt_mesh_prov_bearer_t bearer)
{
	struct mesh_prov_link_open_ev ev;

	LOG_DBG("bearer 0x%02x", bearer);

	switch (bearer) {
	case BT_MESH_PROV_ADV:
		ev.bearer = MESH_PROV_BEARER_PB_ADV;
		break;
	case BT_MESH_PROV_GATT:
		ev.bearer = MESH_PROV_BEARER_PB_GATT;
		break;
	default:
		LOG_ERR("Invalid bearer");

		return;
	}

	tester_send(BTP_SERVICE_ID_MESH, MESH_EV_PROV_LINK_OPEN,
		    CONTROLLER_INDEX, (uint8_t *) &ev, sizeof(ev));
}

static void link_close(bt_mesh_prov_bearer_t bearer)
{
	struct mesh_prov_link_closed_ev ev;

	LOG_DBG("bearer 0x%02x", bearer);

	switch (bearer) {
	case BT_MESH_PROV_ADV:
		ev.bearer = MESH_PROV_BEARER_PB_ADV;
		break;
	case BT_MESH_PROV_GATT:
		ev.bearer = MESH_PROV_BEARER_PB_GATT;
		break;
	default:
		LOG_ERR("Invalid bearer");

		return;
	}

	tester_send(BTP_SERVICE_ID_MESH, MESH_EV_PROV_LINK_CLOSED,
		    CONTROLLER_INDEX, (uint8_t *) &ev, sizeof(ev));
}

static int output_number(bt_mesh_output_action_t action, uint32_t number)
{
	struct mesh_out_number_action_ev ev;

	LOG_DBG("action 0x%04x number 0x%08x", action, number);

	ev.action = sys_cpu_to_le16(action);
	ev.number = sys_cpu_to_le32(number);

	tester_send(BTP_SERVICE_ID_MESH, MESH_EV_OUT_NUMBER_ACTION,
		    CONTROLLER_INDEX, (uint8_t *) &ev, sizeof(ev));

	return 0;
}

static int output_string(const char *str)
{
	struct mesh_out_string_action_ev *ev;
	struct net_buf_simple *buf = NET_BUF_SIMPLE(BTP_DATA_MAX_SIZE);

	LOG_DBG("str %s", log_strdup(str));

	net_buf_simple_init(buf, 0);

	ev = net_buf_simple_add(buf, sizeof(*ev));
	ev->string_len = strlen(str);

	net_buf_simple_add_mem(buf, str, ev->string_len);

	tester_send(BTP_SERVICE_ID_MESH, MESH_EV_OUT_STRING_ACTION,
		    CONTROLLER_INDEX, buf->data, buf->len);

	return 0;
}

static int input(bt_mesh_input_action_t action, uint8_t size)
{
	struct mesh_in_action_ev ev;

	LOG_DBG("action 0x%04x number 0x%02x", action, size);

	input_size = size;

	ev.action = sys_cpu_to_le16(action);
	ev.size = size;

	tester_send(BTP_SERVICE_ID_MESH, MESH_EV_IN_ACTION, CONTROLLER_INDEX,
		    (uint8_t *) &ev, sizeof(ev));

	return 0;
}

static void prov_complete(uint16_t net_idx, uint16_t addr)
{
	LOG_DBG("net_idx 0x%04x addr 0x%04x", net_idx, addr);

	net.net_idx = net_idx,
	net.local = addr;
	net.dst = addr;

	tester_send(BTP_SERVICE_ID_MESH, MESH_EV_PROVISIONED, CONTROLLER_INDEX,
		    NULL, 0);
}

static void prov_reset(void)
{
	LOG_DBG("");

	bt_mesh_prov_enable(BT_MESH_PROV_ADV | BT_MESH_PROV_GATT);
}

static const struct bt_mesh_comp *comp;

static struct bt_mesh_prov prov = {
	.uuid = dev_uuid,
	.static_val = static_auth,
	.static_val_len = sizeof(static_auth),
	.output_number = output_number,
	.output_string = output_string,
	.input = input,
	.link_open = link_open,
	.link_close = link_close,
	.complete = prov_complete,
	.reset = prov_reset,
};

static void config_prov(uint8_t *data, uint16_t len)
{
	const struct mesh_config_provisioning_cmd *cmd = (void *) data;

	LOG_DBG("");

	memcpy(dev_uuid, cmd->uuid, sizeof(dev_uuid));
	memcpy(static_auth, cmd->static_auth, sizeof(static_auth));

	prov.output_size = cmd->out_size;
	prov.output_actions = sys_le16_to_cpu(cmd->out_actions);
	prov.input_size = cmd->in_size;
	prov.input_actions = sys_le16_to_cpu(cmd->in_actions);

	tester_rsp(BTP_SERVICE_ID_MESH, MESH_CONFIG_PROVISIONING,
		   CONTROLLER_INDEX, BTP_STATUS_SUCCESS);
}

static void provision_node(uint8_t *data, uint16_t len)
{
	const struct mesh_provision_node_cmd *cmd = (void *) data;

	LOG_DBG("");

	memcpy(dev_key, cmd->dev_key, sizeof(dev_key));
	memcpy(net_key, cmd->net_key, sizeof(net_key));

	addr = sys_le16_to_cpu(cmd->addr);
	flags = cmd->flags;
	iv_index = sys_le32_to_cpu(cmd->iv_index);
	net_key_idx = sys_le16_to_cpu(cmd->net_key_idx);

	tester_rsp(BTP_SERVICE_ID_MESH, MESH_PROVISION_NODE,
		   CONTROLLER_INDEX, BTP_STATUS_SUCCESS);
}

static void init(uint8_t *data, uint16_t len)
{
	uint8_t status = BTP_STATUS_SUCCESS;
	int err;

	LOG_DBG("");

	comp = model_handler_init();
	err = bt_mesh_init(&prov, comp);
	if (err) {
		status = BTP_STATUS_FAILED;

		goto rsp;
	}

	if (IS_ENABLED(CONFIG_BT_SETTINGS)) {
		printk("Loading stored settings\n");
		settings_load();
	}

	if (addr) {
		err = bt_mesh_provision(net_key, net_key_idx, flags, iv_index,
					addr, dev_key);
		if (err && err != -EALREADY) {
			status = BTP_STATUS_FAILED;
		}
	} else {
		err = bt_mesh_prov_enable(BT_MESH_PROV_ADV | BT_MESH_PROV_GATT);
		if (err && err != -EALREADY) {
			status = BTP_STATUS_FAILED;
		}
	}

	/* Set device key for vendor model */
	vnd_models[0].keys[0] = BT_MESH_KEY_DEV;

rsp:
	tester_rsp(BTP_SERVICE_ID_MESH, MESH_INIT, CONTROLLER_INDEX,
		   status);
}

static void reset(uint8_t *data, uint16_t len)
{
	LOG_DBG("");

	bt_mesh_reset();

	tester_rsp(BTP_SERVICE_ID_MESH, MESH_RESET, CONTROLLER_INDEX,
		   BTP_STATUS_SUCCESS);
}

static void input_number(uint8_t *data, uint16_t len)
{
	const struct mesh_input_number_cmd *cmd = (void *) data;
	uint8_t status = BTP_STATUS_SUCCESS;
	uint32_t number;
	int err;

	number = sys_le32_to_cpu(cmd->number);

	LOG_DBG("number 0x%04x", number);

	err = bt_mesh_input_number(number);
	if (err) {
		status = BTP_STATUS_FAILED;
	}

	tester_rsp(BTP_SERVICE_ID_MESH, MESH_INPUT_NUMBER, CONTROLLER_INDEX,
		   status);
}

static void input_string(uint8_t *data, uint16_t len)
{
	const struct mesh_input_string_cmd *cmd = (void *) data;
	uint8_t status = BTP_STATUS_SUCCESS;
	uint8_t str_auth[16];
	int err;

	LOG_DBG("");

	if (cmd->string_len > sizeof(str_auth)) {
		LOG_ERR("Too long input (%u chars required)", input_size);
		status = BTP_STATUS_FAILED;
		goto rsp;
	} else if (cmd->string_len < input_size) {
		LOG_ERR("Too short input (%u chars required)", input_size);
		status = BTP_STATUS_FAILED;
		goto rsp;
	}

	strncpy(str_auth, cmd->string, cmd->string_len);

	err = bt_mesh_input_string(str_auth);
	if (err) {
		status = BTP_STATUS_FAILED;
	}

rsp:
	tester_rsp(BTP_SERVICE_ID_MESH, MESH_INPUT_STRING, CONTROLLER_INDEX,
		   status);
}

static void ivu_test_mode(uint8_t *data, uint16_t len)
{
	const struct mesh_ivu_test_mode_cmd *cmd = (void *) data;

	LOG_DBG("enable 0x%02x", cmd->enable);

	bt_mesh_iv_update_test(cmd->enable ? true : false);

	tester_rsp(BTP_SERVICE_ID_MESH, MESH_IVU_TEST_MODE, CONTROLLER_INDEX,
		   BTP_STATUS_SUCCESS);
}

static void ivu_toggle_state(uint8_t *data, uint16_t len)
{
	bool result;

	LOG_DBG("");

	result = bt_mesh_iv_update();
	if (!result) {
		LOG_ERR("Failed to toggle the IV Update state");
	}

	tester_rsp(BTP_SERVICE_ID_MESH, MESH_IVU_TOGGLE_STATE, CONTROLLER_INDEX,
		   result ? BTP_STATUS_SUCCESS : BTP_STATUS_FAILED);
}

static void lpn(uint8_t *data, uint16_t len)
{
	struct mesh_lpn_set_cmd *cmd = (void *) data;
	bool enable;
	int err;

	LOG_DBG("enable 0x%02x", cmd->enable);

	enable = cmd->enable ? true : false;
	err = bt_mesh_lpn_set(enable);
	if (err) {
		LOG_ERR("Failed to toggle LPN (err %d)", err);
	}

	tester_rsp(BTP_SERVICE_ID_MESH, MESH_LPN, CONTROLLER_INDEX,
		   err ? BTP_STATUS_FAILED : BTP_STATUS_SUCCESS);
}

static void lpn_poll(uint8_t *data, uint16_t len)
{
	int err;

	LOG_DBG("");

	err = bt_mesh_lpn_poll();
	if (err) {
		LOG_ERR("Failed to send poll msg (err %d)", err);
	}

	tester_rsp(BTP_SERVICE_ID_MESH, MESH_LPN_POLL, CONTROLLER_INDEX,
		   err ? BTP_STATUS_FAILED : BTP_STATUS_SUCCESS);
}

static void net_send(uint8_t *data, uint16_t len)
{
	struct mesh_net_send_cmd *cmd = (void *) data;
	NET_BUF_SIMPLE_DEFINE(msg, UINT8_MAX);
	struct bt_mesh_msg_ctx ctx = {
		.net_idx = net.net_idx,
		.app_idx = BT_MESH_KEY_DEV,
		.addr = sys_le16_to_cpu(cmd->dst),
		.send_ttl = cmd->ttl,
	};
	int err;

	LOG_DBG("ttl 0x%02x dst 0x%04x payload_len %d", ctx.send_ttl,
		ctx.addr, cmd->payload_len);

	net_buf_simple_add_mem(&msg, cmd->payload, cmd->payload_len);

	err = bt_mesh_model_send(&vnd_models[0], &ctx, &msg, NULL, NULL);
	if (err) {
		LOG_ERR("Failed to send (err %d)", err);
	}

	tester_rsp(BTP_SERVICE_ID_MESH, MESH_NET_SEND, CONTROLLER_INDEX,
		   err ? BTP_STATUS_FAILED : BTP_STATUS_SUCCESS);
}

static void health_generate_faults(uint8_t *data, uint16_t len)
{
	struct mesh_health_generate_faults_rp *rp;
	NET_BUF_SIMPLE_DEFINE(buf, sizeof(*rp) + sizeof(cur_faults) +
			      sizeof(reg_faults));
	uint8_t some_faults[] = { 0x01, 0x02, 0x03, 0xff, 0x06 };
	uint8_t cur_faults_count, reg_faults_count;

	rp = net_buf_simple_add(&buf, sizeof(*rp));

	cur_faults_count = MIN(sizeof(cur_faults), sizeof(some_faults));
	memcpy(cur_faults, some_faults, cur_faults_count);
	net_buf_simple_add_mem(&buf, cur_faults, cur_faults_count);
	rp->cur_faults_count = cur_faults_count;

	reg_faults_count = MIN(sizeof(reg_faults), sizeof(some_faults));
	memcpy(reg_faults, some_faults, reg_faults_count);
	net_buf_simple_add_mem(&buf, reg_faults, reg_faults_count);
	rp->reg_faults_count = reg_faults_count;

	bt_mesh_fault_update(&comp->elem[0]);

	tester_send(BTP_SERVICE_ID_MESH, MESH_HEALTH_GENERATE_FAULTS,
		    CONTROLLER_INDEX, buf.data, buf.len);
}

static void health_clear_faults(uint8_t *data, uint16_t len)
{
	LOG_DBG("");

	(void)memset(cur_faults, 0, sizeof(cur_faults));
	(void)memset(reg_faults, 0, sizeof(reg_faults));

	bt_mesh_fault_update(&comp->elem[0]);

	tester_rsp(BTP_SERVICE_ID_MESH, MESH_HEALTH_CLEAR_FAULTS,
		   CONTROLLER_INDEX, BTP_STATUS_SUCCESS);
}

static void model_send(uint8_t *data, uint16_t len)
{
	struct mesh_model_send_cmd *cmd = (void *) data;
	NET_BUF_SIMPLE_DEFINE(msg, UINT8_MAX);
	struct bt_mesh_msg_ctx ctx = {
		.net_idx = net.net_idx,
		.app_idx = BT_MESH_KEY_DEV,
		.addr = sys_le16_to_cpu(cmd->dst),
		.send_ttl = BT_MESH_TTL_DEFAULT,
	};
	struct bt_mesh_model *model = NULL;
	int err, i;
	uint16_t src = sys_le16_to_cpu(cmd->src);

	/* Lookup source address */
	for (i = 0; i < ARRAY_SIZE(model_bound); i++) {
		if (bt_mesh_model_elem(model_bound[i].model)->addr == src) {
			model = model_bound[i].model;
			ctx.app_idx = model_bound[i].appkey_idx;

			break;
		}
	}

	if (!model) {
		LOG_ERR("Model not found");
		err = -EINVAL;

		goto fail;
	}

	LOG_DBG("src 0x%04x dst 0x%04x model %p payload_len %d", src,
		ctx.addr, model, cmd->payload_len);

	net_buf_simple_add_mem(&msg, cmd->payload, cmd->payload_len);

	err = bt_mesh_model_send(model, &ctx, &msg, NULL, NULL);
	if (err) {
		LOG_ERR("Failed to send (err %d)", err);
	}

fail:
	tester_rsp(BTP_SERVICE_ID_MESH, MESH_MODEL_SEND, CONTROLLER_INDEX,
		   err ? BTP_STATUS_FAILED : BTP_STATUS_SUCCESS);
}

#if defined(CONFIG_BT_TESTING)
static void lpn_subscribe(uint8_t *data, uint16_t len)
{
	struct mesh_lpn_subscribe_cmd *cmd = (void *) data;
	uint16_t address = sys_le16_to_cpu(cmd->address);
	int err;

	LOG_DBG("address 0x%04x", address);

	err = bt_test_mesh_lpn_group_add(address);
	if (err) {
		LOG_ERR("Failed to subscribe (err %d)", err);
	}

	tester_rsp(BTP_SERVICE_ID_MESH, MESH_LPN_SUBSCRIBE, CONTROLLER_INDEX,
		   err ? BTP_STATUS_FAILED : BTP_STATUS_SUCCESS);
}

static void lpn_unsubscribe(uint8_t *data, uint16_t len)
{
	struct mesh_lpn_unsubscribe_cmd *cmd = (void *) data;
	uint16_t address = sys_le16_to_cpu(cmd->address);
	int err;

	LOG_DBG("address 0x%04x", address);

	err = bt_test_mesh_lpn_group_remove(&address, 1);
	if (err) {
		LOG_ERR("Failed to unsubscribe (err %d)", err);
	}

	tester_rsp(BTP_SERVICE_ID_MESH, MESH_LPN_UNSUBSCRIBE, CONTROLLER_INDEX,
		   err ? BTP_STATUS_FAILED : BTP_STATUS_SUCCESS);
}

static void rpl_clear(uint8_t *data, uint16_t len)
{
	int err;

	LOG_DBG("");

	err = bt_test_mesh_rpl_clear();
	if (err) {
		LOG_ERR("Failed to clear RPL (err %d)", err);
	}

	tester_rsp(BTP_SERVICE_ID_MESH, MESH_RPL_CLEAR, CONTROLLER_INDEX,
		   err ? BTP_STATUS_FAILED : BTP_STATUS_SUCCESS);
}
#endif /* CONFIG_BT_TESTING */

static void proxy_identity_enable(uint8_t *data, uint16_t len)
{
	int err;

	LOG_DBG("");

	err = bt_mesh_proxy_identity_enable();
	if (err) {
		LOG_ERR("Failed to enable proxy identity (err %d)", err);
	}

	tester_rsp(BTP_SERVICE_ID_MESH, MESH_PROXY_IDENTITY, CONTROLLER_INDEX,
		   err ? BTP_STATUS_FAILED : BTP_STATUS_SUCCESS);
}

void tester_handle_mesh(uint8_t opcode, uint8_t index, uint8_t *data, uint16_t len)
{
	switch (opcode) {
	case MESH_READ_SUPPORTED_COMMANDS:
		supported_commands(data, len);
		break;
	case MESH_CONFIG_PROVISIONING:
		config_prov(data, len);
		break;
	case MESH_PROVISION_NODE:
		provision_node(data, len);
		break;
	case MESH_INIT:
		init(data, len);
		break;
	case MESH_RESET:
		reset(data, len);
		break;
	case MESH_INPUT_NUMBER:
		input_number(data, len);
		break;
	case MESH_INPUT_STRING:
		input_string(data, len);
		break;
	case MESH_IVU_TEST_MODE:
		ivu_test_mode(data, len);
		break;
	case MESH_IVU_TOGGLE_STATE:
		ivu_toggle_state(data, len);
		break;
	case MESH_LPN:
		lpn(data, len);
		break;
	case MESH_LPN_POLL:
		lpn_poll(data, len);
		break;
	case MESH_NET_SEND:
		net_send(data, len);
		break;
	case MESH_HEALTH_GENERATE_FAULTS:
		health_generate_faults(data, len);
		break;
	case MESH_HEALTH_CLEAR_FAULTS:
		health_clear_faults(data, len);
		break;
	case MESH_MODEL_SEND:
		model_send(data, len);
		break;
#if defined(CONFIG_BT_TESTING)
	case MESH_LPN_SUBSCRIBE:
		lpn_subscribe(data, len);
		break;
	case MESH_LPN_UNSUBSCRIBE:
		lpn_unsubscribe(data, len);
		break;
	case MESH_RPL_CLEAR:
		rpl_clear(data, len);
		break;
#endif /* CONFIG_BT_TESTING */
	case MESH_PROXY_IDENTITY:
		proxy_identity_enable(data, len);
		break;
	default:
		tester_rsp(BTP_SERVICE_ID_MESH, opcode, index,
			   BTP_STATUS_UNKNOWN_CMD);
		break;
	}
}

void net_recv_ev(uint8_t ttl, uint8_t ctl, uint16_t src, uint16_t dst, const void *payload,
		 size_t payload_len)
{
	NET_BUF_SIMPLE_DEFINE(buf, UINT8_MAX);
	struct mesh_net_recv_ev *ev;

	LOG_DBG("ttl 0x%02x ctl 0x%02x src 0x%04x dst 0x%04x payload_len %zu",
		ttl, ctl, src, dst, payload_len);

	if (payload_len > net_buf_simple_tailroom(&buf)) {
		LOG_ERR("Payload size exceeds buffer size");
		return;
	}

	ev = net_buf_simple_add(&buf, sizeof(*ev));
	ev->ttl = ttl;
	ev->ctl = ctl;
	ev->src = sys_cpu_to_le16(src);
	ev->dst = sys_cpu_to_le16(dst);
	ev->payload_len = payload_len;
	net_buf_simple_add_mem(&buf, payload, payload_len);

	tester_send(BTP_SERVICE_ID_MESH, MESH_EV_NET_RECV, CONTROLLER_INDEX,
		    buf.data, buf.len);
}

static void model_bound_cb(uint16_t addr, struct bt_mesh_model *model,
			   uint16_t key_idx)
{
	int i;

	LOG_DBG("remote addr 0x%04x key_idx 0x%04x model %p",
		addr, key_idx, model);

	for (i = 0; i < ARRAY_SIZE(model_bound); i++) {
		if (!model_bound[i].model) {
			model_bound[i].model = model;
			model_bound[i].addr = addr;
			model_bound[i].appkey_idx = key_idx;

			return;
		}
	}

	LOG_ERR("model_bound is full");
}

static void model_unbound_cb(uint16_t addr, struct bt_mesh_model *model,
			     uint16_t key_idx)
{
	int i;

	LOG_DBG("remote addr 0x%04x key_idx 0x%04x model %p",
		addr, key_idx, model);

	for (i = 0; i < ARRAY_SIZE(model_bound); i++) {
		if (model_bound[i].model == model) {
			model_bound[i].model = NULL;
			model_bound[i].addr = 0x0000;
			model_bound[i].appkey_idx = BT_MESH_KEY_UNUSED;

			return;
		}
	}

	LOG_INF("model not found");
}

static void invalid_bearer_cb(uint8_t opcode)
{
	struct mesh_invalid_bearer_ev ev = {
		.opcode = opcode,
	};

	LOG_DBG("opcode 0x%02x", opcode);

	tester_send(BTP_SERVICE_ID_MESH, MESH_EV_INVALID_BEARER,
		    CONTROLLER_INDEX, (uint8_t *) &ev, sizeof(ev));
}

static void incomp_timer_exp_cb(void)
{
	tester_send(BTP_SERVICE_ID_MESH, MESH_EV_INCOMP_TIMER_EXP,
		    CONTROLLER_INDEX, NULL, 0);
}

static struct bt_test_cb bt_test_cb = {
	.mesh_net_recv = net_recv_ev,
	.mesh_model_bound = model_bound_cb,
	.mesh_model_unbound = model_unbound_cb,
	.mesh_prov_invalid_bearer = invalid_bearer_cb,
	.mesh_trans_incomp_timer_exp = incomp_timer_exp_cb,
};

uint8_t tester_init_mesh(void)
{
	if (IS_ENABLED(CONFIG_BT_TESTING)) {
		bt_test_cb_register(&bt_test_cb);
	}

	return BTP_STATUS_SUCCESS;
}

uint8_t tester_unregister_mesh(void)
{
	return BTP_STATUS_SUCCESS;
}
```

## src/model_handler.c
```c
/*
 * Copyright (c) 2019 Nordic Semiconductor ASA
 *
 * SPDX-License-Identifier: LicenseRef-BSD-5-Clause-Nordic
 */

#include <bluetooth/bluetooth.h>
#include <bluetooth/mesh/models.h>

#include <logging/log.h>
#define LOG_MODULE_NAME bttester_model_handler
LOG_MODULE_REGISTER(LOG_MODULE_NAME);

#include "bttester.h"
#include "model_handler.h"

/* Vendor Model data */
#define VND_MODEL_ID_1 0x1234
uint8_t cur_faults[CUR_FAULTS_MAX];
uint8_t reg_faults[CUR_FAULTS_MAX * 2];

#define PWM_SIZE_STEP 64

static void pwr_set(struct bt_mesh_plvl_srv *srv, struct bt_mesh_msg_ctx *ctx,
		    const struct bt_mesh_plvl_set *set,
		    struct bt_mesh_plvl_status *rsp);

static void pwr_get(struct bt_mesh_plvl_srv *srv, struct bt_mesh_msg_ctx *ctx,
		    struct bt_mesh_plvl_status *rsp);

static struct bt_mesh_plvl_srv_handlers plvl_handlers = {
	.power_set = pwr_set,
	.power_get = pwr_get,
};

struct lvl_ctx {
	struct bt_mesh_plvl_srv srv;
	struct k_delayed_work work;
	uint32_t remaining;
	uint32_t period;
	uint16_t current;
	uint16_t target;
} lvl_ctx = {
	.srv = BT_MESH_PLVL_SRV_INIT(&plvl_handlers),
};

static void start_new_trans(uint32_t step_cnt,
			    const struct bt_mesh_model_transition *transition,
			    struct lvl_ctx *ctx)
{
	k_delayed_work_cancel(&ctx->work);
	ctx->period = (step_cnt ? transition->time / step_cnt : 0);
	k_delayed_work_submit(&ctx->work, K_MSEC(transition->delay));
}

static void lvl_status(struct lvl_ctx *ctx, struct bt_mesh_plvl_status *rsp)
{
	rsp->current = ctx->current;
	rsp->target = ctx->target;
	rsp->remaining_time = ctx->remaining;
}

static void periodic_led_work(struct k_work *work)
{
	struct lvl_ctx *ctx = CONTAINER_OF(work, struct lvl_ctx, work);

	ctx->remaining -= ctx->period;

	if ((ctx->remaining <= ctx->period) ||
	    (abs(ctx->target - ctx->current) <= PWM_SIZE_STEP)) {
		ctx->current = ctx->target;
		ctx->remaining = 0;
		/* Publish the new value at the end of the transition */
		struct bt_mesh_plvl_status status;

		lvl_status(ctx, &status);
		bt_mesh_plvl_srv_pub(&ctx->srv, NULL, &status);
		return;
	} else if (ctx->target > ctx->current) {
		ctx->current += PWM_SIZE_STEP;
	} else {
		ctx->current -= PWM_SIZE_STEP;
	}

	k_delayed_work_submit(&ctx->work, K_MSEC(ctx->period));
}

static void pwr_set(struct bt_mesh_plvl_srv *srv, struct bt_mesh_msg_ctx *ctx,
		    const struct bt_mesh_plvl_set *set,
		    struct bt_mesh_plvl_status *rsp)
{
	struct lvl_ctx *l_ctx = CONTAINER_OF(srv, struct lvl_ctx, srv);
	uint32_t step_cnt;

	l_ctx->target = set->power_lvl;
	l_ctx->remaining = set->transition->time + set->transition->delay;
	if (l_ctx->remaining) {
		step_cnt = abs(l_ctx->target - l_ctx->current) / PWM_SIZE_STEP;
		start_new_trans(step_cnt, set->transition, l_ctx);
	} else {
		l_ctx->current = l_ctx->target;
	}

	lvl_status(l_ctx, rsp);
}

static void pwr_get(struct bt_mesh_plvl_srv *srv, struct bt_mesh_msg_ctx *ctx,
		    struct bt_mesh_plvl_status *rsp)
{
	struct lvl_ctx *l_ctx = CONTAINER_OF(srv, struct lvl_ctx, srv);

	lvl_status(l_ctx, rsp);
}

static void battery_get(struct bt_mesh_battery_srv *srv,
			struct bt_mesh_msg_ctx *ctx,
			struct bt_mesh_battery_status *rsp);

struct bat_ctx {
	struct bt_mesh_battery_srv srv;
} bat_ctx = {
	.srv = BT_MESH_BATTERY_SRV_INIT(battery_get),
};

static void battery_get(struct bt_mesh_battery_srv *srv,
			struct bt_mesh_msg_ctx *ctx,
			struct bt_mesh_battery_status *rsp)
{
	rsp->battery_lvl = BT_MESH_BATTERY_LVL_UNKNOWN;
	rsp->discharge_minutes = BT_MESH_BATTERY_TIME_UNKNOWN;
	rsp->charge_minutes = BT_MESH_BATTERY_TIME_UNKNOWN;
	rsp->presence = BT_MESH_BATTERY_PRESENCE_UNKNOWN;
	rsp->indicator = BT_MESH_BATTERY_INDICATOR_UNKNOWN;
	rsp->charging = BT_MESH_BATTERY_CHARGING_UNKNOWN;
	rsp->service = BT_MESH_BATTERY_SERVICE_UNKNOWN;
}

static void global_get(struct bt_mesh_loc_srv *srv, struct bt_mesh_msg_ctx *ctx,
		       struct bt_mesh_loc_global *rsp);

static void global_set(struct bt_mesh_loc_srv *srv, struct bt_mesh_msg_ctx *ctx,
		       struct bt_mesh_loc_global *loc);

static void local_get(struct bt_mesh_loc_srv *srv, struct bt_mesh_msg_ctx *ctx,
		      struct bt_mesh_loc_local *rsp);

static void local_set(struct bt_mesh_loc_srv *srv, struct bt_mesh_msg_ctx *ctx,
		      struct bt_mesh_loc_local *loc);

static struct bt_mesh_loc_srv_handlers loc_handlers = {
	.global_get = global_get,
	.global_set = global_set,
	.local_get = local_get,
	.local_set = local_set,
};

struct loc_ctx {
	struct bt_mesh_loc_srv srv;
	struct bt_mesh_loc_global global;
	struct bt_mesh_loc_local local;
} loc_ctx = {
	.srv = BT_MESH_LOC_SRV_INIT(&loc_handlers),
};

static void global_get(struct bt_mesh_loc_srv *srv, struct bt_mesh_msg_ctx *ctx,
		       struct bt_mesh_loc_global *rsp)
{
	struct loc_ctx *l_ctx = CONTAINER_OF(srv, struct loc_ctx, srv);

	*rsp = l_ctx->global;
}

static void global_set(struct bt_mesh_loc_srv *srv, struct bt_mesh_msg_ctx *ctx,
		       struct bt_mesh_loc_global *loc)
{
	struct loc_ctx *l_ctx = CONTAINER_OF(srv, struct loc_ctx, srv);

	l_ctx->global = *loc;
}

static void local_get(struct bt_mesh_loc_srv *srv, struct bt_mesh_msg_ctx *ctx,
		      struct bt_mesh_loc_local *rsp)
{
	struct loc_ctx *l_ctx = CONTAINER_OF(srv, struct loc_ctx, srv);

	*rsp = l_ctx->local;
}

static void local_set(struct bt_mesh_loc_srv *srv, struct bt_mesh_msg_ctx *ctx,
		      struct bt_mesh_loc_local *loc)
{
	struct loc_ctx *l_ctx = CONTAINER_OF(srv, struct loc_ctx, srv);

	l_ctx->local = *loc;
}

static void prop_set(struct bt_mesh_prop_srv *srv, struct bt_mesh_msg_ctx *ctx,
		     struct bt_mesh_prop_val *val);

static void prop_get(struct bt_mesh_prop_srv *srv, struct bt_mesh_msg_ctx *ctx,
		     struct bt_mesh_prop_val *val);

static void prop_mfr_get(struct bt_mesh_prop_srv *srv,
			 struct bt_mesh_msg_ctx *ctx,
			 struct bt_mesh_prop_val *val);

#define PROP_ID 2U
#define PROP_MFR_ID 3U

static struct bt_mesh_prop
	properties[] = { [0] = {
				 .id = PROP_ID,
				 .user_access = BT_MESH_PROP_ACCESS_READ_WRITE,
			 } };

static struct bt_mesh_prop
	mfr_properties[] = { [0] = {
				     .id = PROP_MFR_ID,
				     .user_access = BT_MESH_PROP_ACCESS_READ,
			     } };

static struct {
	uint16_t current;
	uint8_t sensing_duration;
} __attribute__((__packed__)) property;

struct prop_ctx {
	struct bt_mesh_prop_srv admin_srv;
	struct bt_mesh_prop_srv cli_srv;
	struct bt_mesh_prop_srv usr_srv;
	struct bt_mesh_prop_srv mfr_srv;
} prop_ctx = {
	.admin_srv =
		BT_MESH_PROP_SRV_ADMIN_INIT(properties, prop_get, prop_set),
	.cli_srv = BT_MESH_PROP_SRV_CLIENT_INIT(properties),
	.usr_srv = BT_MESH_PROP_SRV_USER_INIT(),
	.mfr_srv = BT_MESH_PROP_SRV_MFR_INIT(mfr_properties, prop_mfr_get),
};

static void prop_set(struct bt_mesh_prop_srv *srv, struct bt_mesh_msg_ctx *ctx,
		     struct bt_mesh_prop_val *val)
{
	if ((val->meta.id != PROP_ID) || (val->size != sizeof(property))) {
		val->meta.id = BT_MESH_PROP_ID_PROHIBITED;
		return;
	}

	property.current = (val->value[1] << 8) | val->value[0];
	property.sensing_duration = val->value[2];
}

static void prop_get(struct bt_mesh_prop_srv *srv, struct bt_mesh_msg_ctx *ctx,
		     struct bt_mesh_prop_val *val)
{
	if (val->meta.id != PROP_ID) {
		val->meta.user_access = BT_MESH_PROP_ACCESS_PROHIBITED;
		return;
	}

	val->size = sizeof(property);
	memcpy(val->value, &property.current, sizeof(property));
}

static void prop_mfr_get(struct bt_mesh_prop_srv *srv,
			 struct bt_mesh_msg_ctx *ctx,
			 struct bt_mesh_prop_val *val)
{
	if (val->meta.id != PROP_MFR_ID) {
		val->meta.user_access = BT_MESH_PROP_ACCESS_PROHIBITED;
		return;
	}

	val->size = sizeof(property);
	memcpy(val->value, &property.current, sizeof(property));
}

static int sensor_data_get(struct bt_mesh_sensor *sensor,
			   struct bt_mesh_msg_ctx *ctx,
			   struct sensor_value *rsp);

static struct bt_mesh_sensor time_since_presence_detected = {
	.type = &bt_mesh_sensor_time_since_presence_detected,
	.get = sensor_data_get,
};

static struct bt_mesh_sensor *const sensors[] = {
	&time_since_presence_detected,
};

static struct sensor_value values[ARRAY_SIZE(sensors)];

static struct bt_mesh_sensor_srv sensor_srv =
	BT_MESH_SENSOR_SRV_INIT(sensors, ARRAY_SIZE(sensors));

static int sensor_data_get(struct bt_mesh_sensor *sensor,
			   struct bt_mesh_msg_ctx *ctx,
			   struct sensor_value *rsp)
{
	int i;

	for (i = 0; i < ARRAY_SIZE(sensors); ++i) {
		if (sensor->type->id != sensors[i]->type->id) {
			continue;
		}

		memcpy(rsp, &values[i], sizeof(*rsp));
		break;
	}

	return 0;
}

void sensor_data_set(uint8_t *data, uint16_t len)
{
	struct mesh_sensor_data_set_cmd *cmd = (void *)data;
	int i;

	for (i = 0; i < ARRAY_SIZE(sensors); ++i) {
		if (cmd->prop_id != sensors[i]->type->id) {
			continue;
		}

		if ((cmd->len > 0) && (cmd->len < sizeof(struct sensor_value))) {
			memcpy(&values[i], cmd->data, cmd->len);
			bt_mesh_sensor_srv_sample(&sensor_srv, sensors[i]);
		}
		break;
	}

	tester_rsp(BTP_SERVICE_ID_MMDL, MMDL_SENSOR_DATA_SET, 0,
		   BTP_STATUS_SUCCESS);
}

static struct bt_mesh_time_srv time_srv = BT_MESH_TIME_SRV_INIT(NULL);

struct lightness_ctx {
	struct bt_mesh_lightness_srv srv;
	struct k_delayed_work work;
	uint32_t remaining;
	uint32_t period;
	uint16_t current;
	uint16_t target;
};

static void
start_new_lightness_trans(uint32_t step_cnt,
			  const struct bt_mesh_model_transition *transition,
			  struct lightness_ctx *ctx)
{
	k_delayed_work_cancel(&ctx->work);
	ctx->period = (step_cnt ? transition->time / step_cnt : 0);
	k_delayed_work_submit(&ctx->work, K_MSEC(transition->delay));
}

static void lightness_status(struct lightness_ctx *ctx,
			     struct bt_mesh_lightness_status *rsp)
{
	rsp->current = ctx->current;
	rsp->target = ctx->target;
	rsp->remaining_time = ctx->remaining;
}

static void periodic_led_lightness_work(struct k_work *work)
{
	struct lightness_ctx *ctx =
		CONTAINER_OF(work, struct lightness_ctx, work);

	ctx->remaining -= ctx->period;

	if ((ctx->remaining <= ctx->period) ||
	    (abs(ctx->target - ctx->current) <= PWM_SIZE_STEP)) {
		ctx->current = ctx->target;
		ctx->remaining = 0;
		/* Publish the new value at the end of the transition */
		struct bt_mesh_lightness_status status;

		lightness_status(ctx, &status);
		bt_mesh_lightness_srv_pub(&ctx->srv, NULL, &status);
		return;
	} else if (ctx->target > ctx->current) {
		ctx->current += PWM_SIZE_STEP;
	} else {
		ctx->current -= PWM_SIZE_STEP;
	}

	k_delayed_work_submit(&ctx->work, K_MSEC(ctx->period));
}

static void light_set(struct bt_mesh_lightness_srv *srv,
		      struct bt_mesh_msg_ctx *ctx,
		      const struct bt_mesh_lightness_set *set,
		      struct bt_mesh_lightness_status *rsp)
{
	struct lightness_ctx *l_ctx =
		CONTAINER_OF(srv, struct lightness_ctx, srv);
	uint32_t step_cnt;

	l_ctx->target = set->lvl;
	l_ctx->remaining = set->transition->time + set->transition->delay;
	if (l_ctx->remaining) {
		step_cnt = abs(l_ctx->target - l_ctx->current) / PWM_SIZE_STEP;
		start_new_lightness_trans(step_cnt, set->transition, l_ctx);
	} else {
		l_ctx->current = l_ctx->target;
	}

	lightness_status(l_ctx, rsp);
}

static void light_get(struct bt_mesh_lightness_srv *srv,
		      struct bt_mesh_msg_ctx *ctx,
		      struct bt_mesh_lightness_status *rsp)
{
	struct lightness_ctx *l_ctx =
		CONTAINER_OF(srv, struct lightness_ctx, srv);

	lightness_status(l_ctx, rsp);
}

static const struct bt_mesh_lightness_srv_handlers lightness_srv_handlers = {
	.light_set = light_set,
	.light_get = light_get,
};

static struct lightness_ctx lightness_ctx = {
	.srv = BT_MESH_LIGHTNESS_SRV_INIT(&lightness_srv_handlers),
};

static struct bt_mesh_light_ctrl_srv light_ctrl_srv =
	BT_MESH_LIGHT_CTRL_SRV_INIT(&lightness_ctx.srv);

static void get_faults(uint8_t *faults, uint8_t faults_size, uint8_t *dst,
		       uint8_t *count)
{
	uint8_t i, limit = *count;

	for (i = 0U, *count = 0U; i < faults_size && *count < limit; i++) {
		if (faults[i]) {
			*dst++ = faults[i];
			(*count)++;
		}
	}
}

static int fault_get_cur(struct bt_mesh_model *model, uint8_t *test_id,
			 uint16_t *company_id, uint8_t *faults,
			 uint8_t *fault_count)
{
	LOG_DBG("");

	*test_id = HEALTH_TEST_ID;
	*company_id = CONFIG_BT_COMPANY_ID;

	get_faults(cur_faults, sizeof(cur_faults), faults, fault_count);

	return 0;
}

static int fault_get_reg(struct bt_mesh_model *model, uint16_t company_id,
			 uint8_t *test_id, uint8_t *faults,
			 uint8_t *fault_count)
{
	LOG_DBG("company_id 0x%04x", company_id);

	if (company_id != CONFIG_BT_COMPANY_ID) {
		return -EINVAL;
	}

	*test_id = HEALTH_TEST_ID;

	get_faults(reg_faults, sizeof(reg_faults), faults, fault_count);

	return 0;
}

static int fault_clear(struct bt_mesh_model *model, uint16_t company_id)
{
	LOG_DBG("company_id 0x%04x", company_id);

	if (company_id != CONFIG_BT_COMPANY_ID) {
		return -EINVAL;
	}

	(void)memset(reg_faults, 0, sizeof(reg_faults));

	return 0;
}

static int fault_test(struct bt_mesh_model *model, uint8_t test_id,
		      uint16_t company_id)
{
	LOG_DBG("test_id 0x%02x company_id 0x%04x", test_id, company_id);

	if (company_id != CONFIG_BT_COMPANY_ID || test_id != HEALTH_TEST_ID) {
		return -EINVAL;
	}

	return 0;
}

static const struct bt_mesh_health_srv_cb health_srv_cb = {
	.fault_get_cur = fault_get_cur,
	.fault_get_reg = fault_get_reg,
	.fault_clear = fault_clear,
	.fault_test = fault_test,
};

static struct bt_mesh_health_srv health_srv = {
	.cb = &health_srv_cb,
};

BT_MESH_HEALTH_PUB_DEFINE(health_pub, CUR_FAULTS_MAX);

struct bt_mesh_model vnd_models[] = {
	BT_MESH_MODEL_VND(CONFIG_BT_COMPANY_ID, VND_MODEL_ID_1,
			  BT_MESH_MODEL_NO_OPS, NULL, NULL),
};

static struct bt_mesh_cfg_cli cfg_cli = {};

void show_faults(uint8_t test_id, uint16_t cid, uint8_t *faults,
		 size_t fault_count)
{
	size_t i;

	if (!fault_count) {
		LOG_DBG("Health Test ID 0x%02x Company ID 0x%04x: no faults",
			test_id, cid);
		return;
	}

	LOG_DBG("Health Test ID 0x%02x Company ID 0x%04x Fault Count %zu: ",
		test_id, cid, fault_count);

	for (i = 0; i < fault_count; i++) {
		LOG_DBG("0x%02x", faults[i]);
	}
}

static void health_current_status(struct bt_mesh_health_cli *cli, uint16_t addr,
				  uint8_t test_id, uint16_t cid,
				  uint8_t *faults, size_t fault_count)
{
	LOG_DBG("Health Current Status from 0x%04x", addr);
	show_faults(test_id, cid, faults, fault_count);
}

static struct bt_mesh_health_cli health_cli = {
	.current_status = health_current_status,
};

static struct bt_mesh_elem elements[] = {
	BT_MESH_ELEM(0,
		     BT_MESH_MODEL_LIST(BT_MESH_MODEL_CFG_SRV,
					BT_MESH_MODEL_CFG_CLI(&cfg_cli),
					BT_MESH_MODEL_HEALTH_SRV(&health_srv,
								 &health_pub),
					BT_MESH_MODEL_HEALTH_CLI(&health_cli),
					BT_MESH_MODEL_PLVL_SRV(&lvl_ctx.srv)),
		     vnd_models),
	BT_MESH_ELEM(1,
		     BT_MESH_MODEL_LIST(
			     BT_MESH_MODEL_BATTERY_SRV(&bat_ctx.srv),
			     BT_MESH_MODEL_LOC_SRV(&loc_ctx.srv),
			     BT_MESH_MODEL_BATTERY_SRV(&bat_ctx.srv),
			     BT_MESH_MODEL_PROP_SRV_ADMIN(&prop_ctx.admin_srv),
			     BT_MESH_MODEL_PROP_SRV_CLIENT(&prop_ctx.cli_srv),
			     BT_MESH_MODEL_PROP_SRV_USER(&prop_ctx.usr_srv),
			     BT_MESH_MODEL_PROP_SRV_MFR(&prop_ctx.mfr_srv),
			     BT_MESH_MODEL_SENSOR_SRV(&sensor_srv),
			     BT_MESH_MODEL_TIME_SRV(&time_srv),
			     BT_MESH_MODEL_LIGHTNESS_SRV(&lightness_ctx.srv)),
		     BT_MESH_MODEL_NONE),
	BT_MESH_ELEM(2,
		     BT_MESH_MODEL_LIST(
			     BT_MESH_MODEL_LIGHT_CTRL_SRV(&light_ctrl_srv)),
		     BT_MESH_MODEL_NONE),
	BT_MESH_ELEM(3,
		     BT_MESH_MODEL_LIST(
			     BT_MESH_MODEL_ONOFF_CLI(&onoff_cli),
			     BT_MESH_MODEL_LVL_CLI(&lvl_cli),
			     BT_MESH_MODEL_DTT_CLI(&dtt_cli),
			     BT_MESH_MODEL_PONOFF_CLI(&ponoff_cli),
			     BT_MESH_MODEL_PLVL_CLI(&plvl_cli),
			     BT_MESH_MODEL_BATTERY_CLI(&battery_cli),
			     BT_MESH_MODEL_LOC_CLI(&loc_cli),
			     BT_MESH_MODEL_PROP_CLI(&prop_cli),
			     BT_MESH_MODEL_SENSOR_CLI(&sensor_cli),
			     BT_MESH_MODEL_TIME_CLI(&time_cli),
			     BT_MESH_MODEL_LIGHTNESS_CLI(&lightness_cli),
			     BT_MESH_MODEL_LIGHT_CTRL_CLI(&light_ctrl_cli),
			 	 BT_MESH_MODEL_LIGHT_CTL_CLI(&light_ctl_cli),
			 	 BT_MESH_MODEL_SCENE_CLI(&scene_cli)),
		     BT_MESH_MODEL_NONE),
};

static const struct bt_mesh_comp comp = {
	.cid = CONFIG_BT_COMPANY_ID,
	.elem = elements,
	.elem_count = ARRAY_SIZE(elements),
};

const struct bt_mesh_comp *model_handler_init(void)
{
	k_delayed_work_init(&lvl_ctx.work, periodic_led_work);
	k_delayed_work_init(&lightness_ctx.work, periodic_led_lightness_work);
	return &comp;
}
```

## src/model_handler.h
```c
/*
 * Copyright (c) 2019 Nordic Semiconductor ASA
 *
 * SPDX-License-Identifier: LicenseRef-BSD-5-Clause-Nordic
 */

/**
 * @file
 * @brief Model handler
 */

#ifndef MODEL_HANDLER_H__
#define MODEL_HANDLER_H__

#include <bluetooth/mesh.h>

#ifdef __cplusplus
extern "C" {
#endif

#define CUR_FAULTS_MAX 4
#define HEALTH_TEST_ID 0x00

const struct bt_mesh_comp *model_handler_init(void);

extern struct bt_mesh_onoff_cli onoff_cli;
extern struct bt_mesh_lvl_cli lvl_cli;
extern struct bt_mesh_dtt_cli dtt_cli;
extern struct bt_mesh_ponoff_cli ponoff_cli;
extern struct bt_mesh_plvl_cli plvl_cli;
extern struct bt_mesh_battery_cli battery_cli;
extern struct bt_mesh_loc_cli loc_cli;
extern struct bt_mesh_prop_cli prop_cli;
extern struct bt_mesh_sensor_cli sensor_cli;
extern struct bt_mesh_time_cli time_cli;
extern struct bt_mesh_lightness_cli lightness_cli;
extern struct bt_mesh_light_ctrl_cli light_ctrl_cli;

struct model_data {
	struct bt_mesh_model *model;
	uint16_t addr;
	uint16_t appkey_idx;
};

/* Model send data */
#define MODEL_BOUNDS_MAX 60

extern struct model_data model_bound[MODEL_BOUNDS_MAX];

struct net_ctx {
	uint16_t local;
	uint16_t dst;
	uint16_t net_idx;
};

extern struct net_ctx net;
void sensor_data_set(uint8_t *data, uint16_t len);

#ifdef __cplusplus
}
#endif

#endif /* MODEL_HANDLER_H__ */
```
